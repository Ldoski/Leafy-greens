/*
 * aifes_inference_nir.cpp
 * ========================
 * AIfES inference energy benchmark for ESP32 — NIR 3-class freshness model.
 *
 * Identical structure to Thesis-Edge-AI aifes_inference.cpp.
 * Only label-related changes: binary sigmoid -> 3-class softmax, argmax prediction.
 *
 * Loads pre-trained float32 weights, runs a forward pass on every test sample,
 * and reports per-class accuracy + per-inference timing. Connect PPK2 to the
 * ESP32 power rail and record while this sketch runs.
 *
 * Architecture: Input(10) -> Dense(16, ReLU) -> Dense(3, Softmax)
 * Data type:    float32 (F32)
 * Framework:    AIfES for Arduino (Fraunhofer IMS) - Express API
 * Labels:       0=Fresh  1=Aging  2=Degraded
 *
 * PPK2 measurement protocol:
 *   1. Flash this sketch and open Serial Monitor (115200 baud)
 *   2. Wait for "=== BENCHMARK START ===" to appear
 *   3. Start PPK2 recording at that moment
 *   4. Stop PPK2 when "=== BENCHMARK END ===" appears
 *   5. Divide total energy by N_REPEATS * N_TEST_NIR for energy-per-inference
 *
 * Headers required (generated by prepare_dataset_NIR.py + train_model_NIR.py):
 *   mould_prediction_dataset_nir.h  -> nir_test_X, nir_test_y, N_TEST_NIR
 *   aifes_weights_nir.h             -> aifes_nir_flat_weights, AIFES_NIR_*_SIZE
 *
 * Dependencies (platformio.ini env:aifes_inference_nir):
 *   https://github.com/Fraunhofer-IMS/AIfES_for_Arduino
 */

#include <Arduino.h>
#include <aifes.h>

#include "mould_prediction_dataset_nir.h"  // nir_test_X, nir_test_y, N_TEST_NIR
#include "aifes_weights_nir.h"             // aifes_nir_flat_weights, AIFES_NIR_*_SIZE

// ---------------------------------------------------------------------------
// Benchmark settings
// ---------------------------------------------------------------------------
#define N_REPEATS     100      // Run the full test set this many times for stable energy reading
#define PRINT_PREDS   false    // Set true to print each prediction (slows benchmark)
#define LED_PIN       2        // Built-in LED: ON during benchmark, OFF before/after

// ---------------------------------------------------------------------------
// AIfES Express model definition
// 3 layers: input(10) + hidden(16,ReLU) + output(3,Softmax)
// ---------------------------------------------------------------------------
static uint32_t           nn_structure[3]   = {AIFES_NIR_INPUT_SIZE, AIFES_NIR_HIDDEN_SIZE, AIFES_NIR_OUTPUT_SIZE};
static AIFES_E_activations nn_activations[2];
static AIFES_E_model_parameter_fnn_f32 nn;

// ---------------------------------------------------------------------------
// Input / output buffers (reused each inference)
// ---------------------------------------------------------------------------
static float input_data[AIFES_NIR_INPUT_SIZE];
static float output_data[AIFES_NIR_OUTPUT_SIZE];  // 3 softmax probabilities

static const char* CLASS_NAMES[3] = {"Fresh", "Aging", "Degraded"};

// ---------------------------------------------------------------------------
// Initialise the AIfES Express model
// ---------------------------------------------------------------------------
void buildModel() {
    nn_activations[0] = AIfES_E_relu;     // hidden layer (Dense 10->16)
    nn_activations[1] = AIfES_E_softmax;  // output layer (Dense 16->3)

    nn.layer_count     = 3;
    nn.fnn_structure   = nn_structure;
    nn.fnn_activations = nn_activations;
    nn.flat_weights    = aifes_nir_flat_weights;  // from aifes_weights_nir.h
}

// ---------------------------------------------------------------------------
// Run one forward pass. Fills output_data[] with 3 softmax probabilities.
// Returns predicted class (argmax).
// ---------------------------------------------------------------------------
uint8_t runInference(const float* features) {
    memcpy(input_data, features, AIFES_NIR_INPUT_SIZE * sizeof(float));

    uint16_t input_shape[]  = {1, AIFES_NIR_INPUT_SIZE};
    uint16_t output_shape[] = {1, AIFES_NIR_OUTPUT_SIZE};

    aitensor_t input_tensor  = AITENSOR_2D_F32(input_shape,  input_data);
    aitensor_t output_tensor = AITENSOR_2D_F32(output_shape, output_data);

    int8_t err = AIFES_E_inference_fnn_f32(&input_tensor, &nn, &output_tensor);
    if (err != 0) {
        Serial.printf("ERROR: AIFES_E_inference_fnn_f32 returned %d\n", err);
        return 255;
    }

    // Argmax over 3 softmax outputs
    uint8_t pred = 0;
    for (uint8_t c = 1; c < AIFES_NIR_OUTPUT_SIZE; c++) {
        if (output_data[c] > output_data[pred]) pred = c;
    }
    return pred;
}

// ---------------------------------------------------------------------------
// Setup
// ---------------------------------------------------------------------------
void setup() {
    pinMode(LED_PIN, OUTPUT);
    digitalWrite(LED_PIN, LOW);

    Serial.begin(115200);
    while (!Serial) delay(10);

    Serial.println("\n========================================");
    Serial.println("  AIfES Inference Benchmark — NIR 3-Class (Express API)");
    Serial.println("  Architecture: 10 -> Dense(16,ReLU) -> Dense(3,Softmax)");
    Serial.println("  Data type: float32  |  Labels: Fresh / Aging / Degraded");
    Serial.println("========================================");
    Serial.printf("  Weights      : %d floats\n", AIFES_NIR_N_WEIGHTS);
    Serial.printf("  Test samples : %d\n", N_TEST_NIR);
    Serial.printf("  Repeats      : %d\n", N_REPEATS);
    Serial.printf("  Total inferences: %d\n", N_TEST_NIR * N_REPEATS);

    buildModel();
    Serial.println("\nModel built and weights loaded.");
    Serial.println("Starting in 2 seconds... (start PPK2 now)");
    delay(2000);

    // -----------------------------------------------------------------------
    // BENCHMARK START -- LED turns ON
    // -----------------------------------------------------------------------
    digitalWrite(LED_PIN, HIGH);
    Serial.println("\n=== BENCHMARK START ===");

    uint32_t class_correct[3] = {0, 0, 0};
    uint32_t class_total[3]   = {0, 0, 0};
    uint32_t total_correct    = 0;
    uint32_t total_samples    = 0;
    uint32_t t_start          = micros();

    for (int rep = 0; rep < N_REPEATS; rep++) {
        for (int i = 0; i < N_TEST_NIR; i++) {
            uint8_t pred   = runInference(nir_test_X[i]);
            uint8_t actual = nir_test_y[i];

            if (rep == 0) class_total[actual]++;
            if (pred == actual) {
                total_correct++;
                if (rep == 0) class_correct[actual]++;
            }
            total_samples++;

#if PRINT_PREDS
            if (rep == 0) {
                Serial.printf("  [%3d] pred=%s actual=%s probs=[%.3f %.3f %.3f] %s\n",
                              i, CLASS_NAMES[pred], CLASS_NAMES[actual],
                              output_data[0], output_data[1], output_data[2],
                              pred == actual ? "OK" : "WRONG");
            }
#endif
        }
    }

    uint32_t t_end = micros();
    // -----------------------------------------------------------------------
    // BENCHMARK END -- LED turns OFF
    // -----------------------------------------------------------------------
    digitalWrite(LED_PIN, LOW);
    Serial.println("=== BENCHMARK END ===\n");

    uint32_t elapsed_us       = t_end - t_start;
    float    us_per_inference = (float)elapsed_us / (float)total_samples;
    float    ms_per_inference = us_per_inference / 1000.0f;
    float    accuracy         = 100.0f * total_correct / total_samples;

    Serial.println("--- Results ---");
    Serial.printf("  Total inferences  : %u\n", total_samples);
    Serial.printf("  Correct           : %u\n", total_correct);
    Serial.printf("  Overall accuracy  : %.1f%%\n", accuracy);
    Serial.println("  Per-class accuracy (first repeat only):");
    for (int c = 0; c < 3; c++) {
        if (class_total[c] > 0) {
            Serial.printf("    %-10s : %.1f%%  (%u / %u)\n",
                          CLASS_NAMES[c],
                          100.0f * class_correct[c] / class_total[c],
                          class_correct[c], class_total[c]);
        }
    }
    Serial.printf("  Total time        : %u us (%.2f ms)\n", elapsed_us, elapsed_us / 1000.0f);
    Serial.printf("  Time/inference    : %.1f us (%.3f ms)\n", us_per_inference, ms_per_inference);
    Serial.println("\nRecord PPK2 energy between BENCHMARK START and END.");
    Serial.println("Energy/inference = total_energy_uJ / total_inferences");
}

void loop() {
    delay(10000);
}
